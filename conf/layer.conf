## conf/layer.conf
```bitbake
# We have a conf and classes directory, add to BBPATH
BBPATH .= ":${LAYERDIR}"

# We have recipes-* directories, add to BBFILES
BBFILES += "${LAYERDIR}/recipes-*/*/*.bb \
            ${LAYERDIR}/recipes-*/*/*.bbappend"

BBFILE_COLLECTIONS += "meta-kvmd"
BBFILE_PATTERN_meta-kvmd = "^${LAYERDIR}/"
BBFILE_PRIORITY_meta-kvmd = "6"

LAYERDEPENDS_meta-kvmd = "core"
LAYERSERIES_COMPAT_meta-kvmd = "dunfell"
```
